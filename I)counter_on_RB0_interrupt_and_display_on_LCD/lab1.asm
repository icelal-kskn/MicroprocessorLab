;200316059 Ikram Celal EKSKIN
;200316011 Musa Sina ERTUGRUL

LIST P = PIC16F877A
#INCLUDE <P16F877A.INC>	
__CONFIG H'3F31'

#define RS PORTC,0 ; Lcd Data/Command
#define RW PORTC,1 ; Read/Write Data
#define EN PORTC,2 ; LCD Enable

S1 		EQU 0X20	; Delay var
S2 		EQU 0X21	; Delay var
TEMP		EQU 0X22 	; For Working Reg Back-up
CHAR    	EQU 0X23	; For Counter Display next char;
CHAR2		EQU	0X24
;First 	Address--------------------------
ORG 		0x00
START

CALL REG_INIT			
CALL LCD_INIT

MOVLW	0x80
CALL	LCD_COMMAND
MOVLW	0X01
CALL 	LCD_COMMAND

POLL
BTFSS	PORTB,0
GOTO	POLL
CALL	WRITE_COUNTER
CALL 	PRINT
MOVLW	0X02
CALL 	LCD_COMMAND
GOTO 	POLL

WRITE_COUNTER
MOVLW	"C"
CALL	LCD_DATA
CALL	SHIFT_RIGHT
MOVLW	"o"
CALL	LCD_DATA
CALL	SHIFT_RIGHT
MOVLW	"u"
CALL	LCD_DATA
CALL	SHIFT_RIGHT
MOVLW	"n"
CALL	LCD_DATA
CALL	SHIFT_RIGHT
MOVLW	"t"
CALL	LCD_DATA
CALL	SHIFT_RIGHT
MOVLW	"e"
CALL	LCD_DATA
CALL	SHIFT_RIGHT
MOVLW	"r"
CALL	LCD_DATA
CALL	SHIFT_RIGHT
MOVLW	":"
CALL	LCD_DATA
CALL	SHIFT_RIGHT
RETURN

SHIFT_LEFT
MOVLW	0X04
CALL 	LCD_COMMAND
RETURN

SHIFT_RIGHT
MOVLW	0X06
CALL 	LCD_COMMAND
RETURN

;TRIS REG Initialization for PORT A B C ----------------------------------------------
REG_INIT
BANKSEL TRISC
MOVLW   B'00000001'
MOVWF	TRISB
CLRF	TRISC
CLRF	TRISD
BANKSEL PORTD
CLRF	PORTD
CLRF	PORTB
CLRF 	CHAR
RETURN
;For Printing Char on LCD Display----------------------------------------------------
PRINT
BANKSEL CHAR
BCF		STATUS,C
MOVLW	D'10'
SUBWF	CHAR2,W
BTFSS	STATUS,C
GOTO	PRINT2
CLRF	CHAR2
PRINT2
MOVLW	"0"
ADDWF 	CHAR,0
CALL 	LCD_DATA
CALL	SHIFT_RIGHT
MOVLW	"0"
ADDWF 	CHAR2,0
CALL 	LCD_DATA
CALL	SHIFT_RIGHT
INCF	CHAR2
BCF		STATUS,C
MOVLW	D'10'
SUBWF	CHAR2,W
BTFSS	STATUS,C
RETURN
INCF	CHAR
RETURN
;For LCD Display Initialization-------------------------------------------------------
LCD_INIT
MOVLW	0X38			
CALL 	LCD_COMMAND
MOVLW 	0X06
CALL	LCD_COMMAND
MOVLW	0X0E
CALL	LCD_COMMAND
MOVLW	0X01
CALL 	LCD_COMMAND
RETURN
;--------------------------------------------------------------------------------------
LCD_COMMAND
BCF		RS
BCF		RW
BSF		EN
MOVWF 	TEMP
CALL 	DELAY
MOVFW	TEMP
BANKSEL	PORTD
MOVWF	PORTD
BCF		EN
RETURN
;----------------------------------------------------------------------------------
LCD_DATA
BSF		RS
BCF		RW
BSF		EN
MOVWF 		TEMP
CALL 		DELAY
MOVFW		TEMP
BANKSEL		PORTD
MOVWF		PORTD
BCF		EN
RETURN
;------------FOR DELAY-----------
DELAY
MOVLW 0XFF
MOVWF S1
L1
	MOVLW 0XFF
	MOVWF S2
	L2
		DECFSZ S2
		GOTO   L2
	DECFSZ S1
	GOTO   L1
RETURN	

END